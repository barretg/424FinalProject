/dts-v1/;
/plugin/;

/ {
    fragment@0 {
        target-path="/";
        __overlay__ {
            final-project {
                compatible = "two-compatible";
				        encoder-gpios = <&gpio 24 0 >;
            };
        };
    };

};

